## conf/layer.conf
```bitbake
# We have a conf and classes directory, add to BBPATH
BBPATH .= ":${LAYERDIR}"

# We have recipes-* directories, add to BBFILES
BBFILES += "${LAYERDIR}/recipes-*/*/*.bb \
            ${LAYERDIR}/recipes-*/*/*.bbappend"

BBFILE_COLLECTIONS += "meta-raspberrypi-baremetal"
BBFILE_PATTERN_meta-raspberrypi-baremetal = "^${LAYERDIR}/"
BBFILE_PRIORITY_meta-raspberrypi-baremetal = "6"

LAYERDEPENDS_meta-raspberrypi-baremetal = "core"
LAYERSERIES_COMPAT_meta-raspberrypi-baremetal = "mickledore"

PICO_SDK_SRCREV ?= "6a7db34ff63345a7badec79ebea3aaef1712f374"
```

## conf/machine/raspberrypi-pico.conf
```bitbake
#@TYPE: Machine
#@NAME: RaspberryPi Pico
#@DESCRIPTION: Machine configuration for ARM Cortex-M0+

require conf/machine/include/arm/armv6m/tune-cortexm0plus.inc

RASPI_BOARD ?= "pico"

# This should only be built using tclibc-newlib
TCLIBC ?= "newlib"

# We used to get these from DISTRO=poky, include them since we no longer
# build using poky
require conf/distro/include/security_flags.inc

# Removed from bitbake.conf in 1797741aad02b8bf429fac4b81e30cdda64b5448
# We need this so --sysroot= is passed correctly to CMAKE_C_LINK_FLAGS
TARGET_LDFLAGS:append:class-target = " ${DEBUG_PREFIX_MAP}"
```
